# TEST_BANK: IP-XACT component
VLNV your.company:your.library:TEST_BANK:1.0

## Address spaces and blocks
TEST_BANK.TEST_BANK: base 0x0, range 0x100, width 32

## Registers
Registers are 32-bit, read-write, reset 0x0 unless marked. A register's access mark holds for its fields unless they carry their own. Offsets are from the block's base; lines under a group give offsets from that group; [hi:lo] are bit positions; {n}, {i} and the like mark numbered series; 'fields as' and 'values as' point back to an identical list; <NAME> marks a mode.

## TEST_BANK.TEST_BANK
Base 0x00000000
0x00 Register0
  [31:0] reg0_field0
0x04 Register1 ro
  [31:0] reg1_field0
0x08 Register2
  [31:0] reg2_field0
0x0C Register3 wo
  [31:0] reg3_field0
